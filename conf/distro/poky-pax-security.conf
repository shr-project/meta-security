## conf/distro/poky-pax-security.conf
```bitbake
require conf/distro/poky-security.conf

DISTRO = "poky-pax-security"


PREFERRED_PROVIDER_virtual/kernel = "linux-pax"
PREFERRED_VERSION_linux-pax = "3.14"

DISTRO_FEATURES  += "pax"
```

## conf/distro/poky-security.conf
```bitbake
require conf/distro/poky.conf
require conf/distro/include/security_flags.inc

DISTRO = "poky-security"
```
